## src/application/samples/peripheral/semaphore/Kconfig
```kconfig
choice
    prompt "Select semaphore type"
    default SAMPLE_SUPPORT_BINARY_SEMAPHORE
    config SAMPLE_SUPPORT_BINARY_SEMAPHORE
        bool "Enable Binary Semaphore."
    config SAMPLE_SUPPORT_COUNT_SEMAPHORE
        bool "Enable Count Semaphore."

endchoice
```

## src/application/samples/peripheral/sg90/Kconfig
```kconfig
#===============================================================================
# @brief    Kconfig file for SG90 Servo
# Copyright (c) HiSilicon (Shanghai) Technologies Co., Ltd. 2025-2025. All rights reserved.
#===============================================================================
# SG90 Servo Sample Configuration
config SG90_GPIO_PIN
    int "SG90 Servo GPIO Pin"
    default 12
    help
        GPIO pin number for SG90 servo control signal.

config SG90_PWM_CHANNEL
    int "SG90 Servo PWM Channel"
    default 4
    help
        PWM channel number for SG90 servo.

config SG90_INIT_ANGLE
    int "SG90 Servo Initial Angle"
    default 90
    range 0 180
    help
        Initial angle when servo initializes (0-180 degrees).
```

## src/application/samples/peripheral/smart_car/Kconfig
```kconfig
#===============================================================================
# 智能小车配置
#===============================================================================

# --- 1. 运行模式选择 (互斥：一次只能跑一个程序) ---
choice SMART_CAR_RUN_MODE
    prompt "Select Running Application"
    default SMART_CAR_RUN_ROBOT_DEMO
    help
        选择要编译和运行的主应用程序

    config SMART_CAR_RUN_ROBOT_DEMO
        bool "Robot Demo (Tracking & Obstacle Avoidance)"
        select SMART_CAR_DRIVER_L9110S
        select SMART_CAR_DRIVER_HCSR04
        select SMART_CAR_DRIVER_TCRT5000
        select SMART_CAR_DRIVER_SSD1306
        select SMART_CAR_DRIVER_WIFI
        select SMART_CAR_DRIVER_UART
        help
            主要集成应用

    config SMART_CAR_RUN_L9110S_TEST
        bool "Test: L9110S Motor"
        select SMART_CAR_DRIVER_L9110S

    config SMART_CAR_RUN_HCSR04_TEST
        bool "Test: HC-SR04 Ultrasonic"
        select SMART_CAR_DRIVER_HCSR04

    config SMART_CAR_RUN_TCRT5000_TEST
        bool "Test: TCRT5000 Line Sensor"
        select SMART_CAR_DRIVER_TCRT5000

    config SMART_CAR_RUN_SSD1306_TEST
        bool "Test: SSD1306 OLED"
        select SMART_CAR_DRIVER_SSD1306

    config SMART_CAR_RUN_WIFI_TEST
        bool "Test: WiFi Client"
        select SMART_CAR_DRIVER_WIFI

    config SMART_CAR_RUN_BT_SPP_TEST
        bool "Test: Bluetooth SPP"
        select SMART_CAR_DRIVER_BT_SPP

endchoice

# --- 2. 驱动开关定义 (被上面自动选中) ---
menu "Drivers Status"
    config SMART_CAR_DRIVER_L9110S
        bool "L9110S Driver"
    
    config SMART_CAR_DRIVER_HCSR04
        bool "HC-SR04 Driver"

    config SMART_CAR_DRIVER_TCRT5000
        bool "TCRT5000 Driver"

    config SMART_CAR_DRIVER_SSD1306
        bool "SSD1306 Driver"

    config SMART_CAR_DRIVER_WIFI
        bool "WiFi Driver"

    config SMART_CAR_DRIVER_BT_SPP
        bool "Bluetooth SPP Driver"

    config SMART_CAR_DRIVER_UART
        bool "UART Driver"
endmenu

# --- 3. WiFi模式选择 ---
choice SMART_CAR_WIFI_MODE
    prompt "WiFi Working Mode"
    default SMART_CAR_WIFI_MODE_AP
    depends on SMART_CAR_DRIVER_WIFI
    help
        选择WiFi工作模式

    config SMART_CAR_WIFI_MODE_STA
        bool "STA Mode (Connect to Router)"
        help
            STA模式：连接到指定的路由器
            SSID: BSHZ-2.4G
            Password: BS666888

    config SMART_CAR_WIFI_MODE_AP
        bool "AP Mode (Hotspot)"
        help
            AP模式：开发板作为热点
            SSID: WS63_Robot
            Password: 12345678
            IP: 192.168.43.1
endchoice

config SMART_CAR_WIFI_MODE
    int
    default 0 if SMART_CAR_WIFI_MODE_STA
    default 1 if SMART_CAR_WIFI_MODE_AP
```

## src/application/samples/peripheral/smart_car/bt_control/Kconfig
```kconfig
#===============================================================================
# @brief    Kconfig file
# Copyright (c) HiSilicon (Shanghai) Technologies Co., Ltd. 2025-2025. All rights reserved.
#===============================================================================

config SMART_CAR_SUPPORT_BT_CONTROL
    bool "Support Bluetooth SPP Control Example"
    default n
    depends on SMART_CAR_L9110S_ENABLE
    help
        蓝牙SPP控制示例 - 通过蓝牙SPP接收控制命令控制小车运动

        控制协议:
        数字命令:
        - 发送 "0": 前进
        - 发送 "1": 后退
        - 发送 "2": 左转
        - 发送 "3": 右转
        - 发送 "4": 停止

        字符命令:
        - 发送 "F" 或 "f": 前进 (Forward)
        - 发送 "B" 或 "b": 后退 (Backward)
        - 发送 "L" 或 "l": 左转 (Left)
        - 发送 "R" 或 "r": 右转 (Right)
        - 发送 "S" 或 "s": 停止 (Stop)

        使用说明:
        1. 编译并烧录程序
        2. 使用手机蓝牙APP连接 "WS63_SmartCar"
        3. 使用SPP功能发送控制命令
        4. 支持串口助手或蓝牙调试APP

        注意: 此模块需要WS63蓝牙SPP API支持，当前为框架代码，
              需要根据实际API调整bt_spp_xxx函数调用
```

## src/application/samples/peripheral/smart_car/hcsr04/Kconfig
```kconfig
#===============================================================================
# @brief    Kconfig file.
# Copyright (c) HiSilicon (Shanghai) Technologies Co., Ltd. 2025-2025. All rights reserved.
#===============================================================================

config SMART_CAR_HCSR04_ENABLE
    bool "Enable HC-SR04 Ultrasonic Sensor"
    default y
    depends on SAMPLE_SUPPORT_SMART_CAR
    help
        Enable HC-SR04 ultrasonic sensor for smart car.
```

## src/application/samples/peripheral/smart_car/l9110s/Kconfig
```kconfig
#===============================================================================
# @brief    Kconfig file.
# Copyright (c) HiSilicon (Shanghai) Technologies Co., Ltd. 2025-2025. All rights reserved.
#===============================================================================

config SMART_CAR_L9110S_ENABLE
    bool "Enable L9110S Motor Driver"
    default y
    depends on SAMPLE_SUPPORT_SMART_CAR
    help
        Enable L9110S motor driver for smart car.
```

## src/application/samples/peripheral/smart_car/robot_demo/Kconfig
```kconfig
#===============================================================================
# @brief    Kconfig file.
# Copyright (c) HiSilicon (Shanghai) Technologies Co., Ltd. 2025-2025. All rights reserved.
#===============================================================================

config SMART_CAR_ROBOT_DEMO_ENABLE
    bool "Enable Robot Demo (Tracking & Obstacle Avoidance)"
    default y
    depends on SAMPLE_SUPPORT_SMART_CAR
    select SMART_CAR_L9110S_ENABLE
    select SMART_CAR_HCSR04_ENABLE
    select SMART_CAR_TCRT5000_ENABLE
    help
        Enable robot demo with tracking and obstacle avoidance features.
```

## src/application/samples/peripheral/smart_car/sg90/Kconfig
```kconfig
#===============================================================================
# @brief    Kconfig file
# Copyright (c) HiSilicon (Shanghai) Technologies Co., Ltd. 2025-2025. All rights reserved.
#===============================================================================

config SMART_CAR_SUPPORT_SG90
    bool "Support SG90 Servo Sample."
    default n
    help
        SG90舵机示例 - 舵机从0度转到180度，再从180度转回0度，循环往复

        硬件连接:
        - GPIO 13 (JP4 舵机接口 SG1)
        注意: GPIO_13 也连接了 LED2 (蓝色)，控制舵机时蓝色LED2会闪烁
```

## src/application/samples/peripheral/smart_car/ssd1306/Kconfig
```kconfig
#===============================================================================
# @brief    Kconfig file
# Copyright (c) HiSilicon (Shanghai) Technologies Co., Ltd. 2025-2025. All rights reserved.
#===============================================================================

config SMART_CAR_SUPPORT_SSD1306
    bool "Support SSD1306 OLED Display Sample."
    default n
    help
        SSD1306 OLED显示屏示例 - 显示字符和图形

        硬件连接 (I2C接口):
        - SCL: GPIO 15 (I2C1_SCL, UART1_TX)
        - SDA: GPIO 16 (I2C1_SDA, UART1_RX)
        - VCC: 3.3V 或 5V (根据模块要求)
        - GND: GND

        I2C地址: 0x3C
        分辨率: 128x64
        接口: I2C
```

## src/application/samples/peripheral/smart_car/tcrt5000/Kconfig
```kconfig
#===============================================================================
# @brief    Kconfig file.
# Copyright (c) HiSilicon (Shanghai) Technologies Co., Ltd. 2025-2025. All rights reserved.
#===============================================================================

config SMART_CAR_TCRT5000_ENABLE
    bool "Enable TCRT5000 Infrared Line Tracking Sensor"
    default y
    depends on SAMPLE_SUPPORT_SMART_CAR
    help
        Enable TCRT5000 infrared line tracking sensor for smart car.
```

## src/application/samples/peripheral/smart_car/wifi_control/Kconfig
```kconfig
#===============================================================================
# @brief    Kconfig file
# Copyright (c) HiSilicon (Shanghai) Technologies Co., Ltd. 2025-2025. All rights reserved.
#===============================================================================

config SMART_CAR_SUPPORT_WIFI_CONTROL
    bool "Support WiFi/TCP Control Example"
    default n
    depends on SMART_CAR_L9110S_ENABLE
    help
        WiFi TCP控制示例 - 通过WiFi接收控制命令控制小车运动

        控制协议:
        - 发送 "0": 前进
        - 发送 "1": 后退
        - 发送 "2": 左转
        - 发送 "3": 右转
        - 发送 "4": 停止

        使用说明:
        1. 修改代码中的 WIFI_SSID 和 WIFI_PASSWORD
        2. 编译并烧录程序
        3. 小车连接到WiFi后，获取IP地址
        4. 使用TCP客户端连接小车IP:8888
        5. 发送控制命令
```

## src/application/samples/peripheral/thread/Kconfig
```kconfig
#===============================================================================
# @brief    Kconfig file.
# Copyright (c) HiSilicon (Shanghai) Technologies Co., Ltd. 2024-2024. All rights reserved.
#===============================================================================
config LED_BLUE_PIN
    int
    prompt "Choose LED_BLUE_PIN pin."
    default 3
```

## src/application/samples/products/Kconfig
```kconfig
config SAMPLE_SUPPORT_SLE_UART
    bool
    prompt "Support SLE UART sample."
    default n
    depends on ENABLE_PRODUCTS_SAMPLE
    help
        This option means support SLE UART Sample

if SAMPLE_SUPPORT_SLE_UART
menu "SLE UART Sample Configuration"
    osource "application/samples/products/sle_uart/Kconfig"
endmenu
endif
```

## src/application/samples/products/sle_uart/Kconfig
```kconfig
config SLE_UART_BUS
    int
    prompt "Set the UART UBS of the current sample."
    default 0
    depends on SAMPLE_SUPPORT_SLE_UART
    help
        This option means the UART BUS of the current sample.

config UART_TXD_PIN
    int 
    prompt "Choose UART TXD pin."
    depends on SAMPLE_SUPPORT_SLE_UART
    default 17

config UART_RXD_PIN
    int 
    prompt "Choose UART RXD pin."
    depends on SAMPLE_SUPPORT_SLE_UART
    default 18

choice
    prompt "Select sle uart type"
    default SAMPLE_SUPPORT_SLE_UART_SERVER
    config SAMPLE_SUPPORT_SLE_UART_SERVER
        bool "Enable SLE UART Server sample."
    config SAMPLE_SUPPORT_SLE_UART_CLIENT
        bool "Enable SLE UART Client sample."
endchoice

config SUPPORT_SLE_PERIPHERAL
    bool
    default y if (SAMPLE_SUPPORT_SLE_UART_SERVER)
```
