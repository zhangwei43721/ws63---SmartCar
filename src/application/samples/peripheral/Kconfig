## src/application/samples/peripheral/Kconfig
```kconfig
#===============================================================================
# @brief    Kconfig file.
# Copyright (c) HiSilicon (Shanghai) Technologies Co., Ltd. 2023-2023. All rights reserved.
#===============================================================================
config ENABLE_ALL_PERIPHERAL_SAMPLE
    bool
    prompt "Enable all the sample of peripheral, it's just for build."
    default n
    depends on ENABLE_PERIPHERAL_SAMPLE
    select SAMPLE_SUPPORT_ADC
    select SAMPLE_SUPPORT_AMIC if ADC_SUPPORT_AMIC
    select SAMPLE_SUPPORT_BLINKY
    select SAMPLE_SUPPORT_THREAD
    select SAMPLE_SUPPORT_BUTTON
    select SAMPLE_SUPPORT_CALENDAR
    select SAMPLE_SUPPORT_CLOCKS
    select SAMPLE_SUPPORT_DMA
    select SAMPLE_SUPPORT_EFLASH
    select SAMPLE_SUPPORT_I2C
    select SAMPLE_SUPPORT_I2S
    select SAMPLE_SUPPORT_I2S_DMA
    select SAMPLE_SUPPORT_I2S_DMA_LLI
    select SAMPLE_SUPPORT_KEYSCAN
    select SAMPLE_SUPPORT_PDM
    select SAMPLE_SUPPORT_PDM_AMIC if ADC_SUPPORT_AMIC
    select SAMPLE_SUPPORT_PINCTRL
    select SAMPLE_SUPPORT_PWM
    select SAMPLE_SUPPORT_QDEC
    select SAMPLE_SUPPORT_RTC
    select SAMPLE_SUPPORT_SPI
    select SAMPLE_SUPPORT_SYSTICK
    select SAMPLE_SUPPORT_TASKS
    select SAMPLE_SUPPORT_TCXO
    select SAMPLE_SUPPORT_TIMER
    select SAMPLE_SUPPORT_UART
    select SAMPLE_SUPPORT_WDT
    help
        This option means enable all the sample of peripheral, it is just for build.

config SAMPLE_SUPPORT_ADC
    bool
    prompt "Support ADC Sample."
    default n
    depends on ENABLE_PERIPHERAL_SAMPLE
    help
        This option means support ADC Sample.

if SAMPLE_SUPPORT_ADC
menu "ADC Sample Configuration"
    osource "application/samples/peripheral/adc/Kconfig"
endmenu
endif

config SAMPLE_SUPPORT_AMIC
    bool
    prompt "Support AMIC Sample."
    default n
    depends on ENABLE_PERIPHERAL_SAMPLE
    help
        This option means support AMIC Sample.

if SAMPLE_SUPPORT_AMIC
menu "AFE Sample Configuration"
    osource "application/samples/peripheral/amic/Kconfig"
endmenu
endif

config SAMPLE_SUPPORT_BLINKY
    bool
    prompt "Support BLINKY Sample."
    default n
    depends on ENABLE_PERIPHERAL_SAMPLE
    help
        This option means support BLINKY Sample.

if SAMPLE_SUPPORT_BLINKY
menu "Blinky Sample Configuration"
    osource "application/samples/peripheral/blinky/Kconfig"
endmenu
endif

config SAMPLE_SUPPORT_BUTTON
    bool
    prompt "Support BUTTON Sample."
    default n
    depends on ENABLE_PERIPHERAL_SAMPLE
    help
        This option means support BUTTON Sample.
if SAMPLE_SUPPORT_BUTTON
menu "BUTTON Sample Configuration"
    osource "application/samples/peripheral/button/Kconfig"
endmenu
endif

config SAMPLE_SUPPORT_CALENDAR
    bool
    prompt "Support CALENDAR Sample."
    default n
    depends on ENABLE_PERIPHERAL_SAMPLE
    help
        This option means support CALENDAR Sample.

if SAMPLE_SUPPORT_CALENDAR
menu "CALENDAR Sample Configuration"
    osource "application/samples/peripheral/calendar/Kconfig"
endmenu
endif

config SAMPLE_SUPPORT_CAN
    bool
    prompt "Support CAN Sample."
    default n
    depends on ENABLE_PERIPHERAL_SAMPLE
    select DRIVER_SUPPORT_CAN_FD
    help
        This option means support CAN Sample.

if SAMPLE_SUPPORT_CAN
menu "CAN Sample Configuration"
    osource "application/samples/peripheral/can/Kconfig"
endmenu
endif
config SAMPLE_SUPPORT_CLOCKS
    bool
    prompt "Support CLOCKS Sample."
    default n
    depends on ENABLE_PERIPHERAL_SAMPLE
    help
        This option means support CLOCKS Sample.

if SAMPLE_SUPPORT_CLOCKS
menu "CLOCKS Sample Configuration"
    osource "application/samples/peripheral/clocks/Kconfig"
endmenu
endif

config SAMPLE_SUPPORT_DMA
    bool
    prompt "Support DMA Sample."
    default n
    depends on ENABLE_PERIPHERAL_SAMPLE
    help
        This option means support DMA Sample.

if SAMPLE_SUPPORT_DMA
menu "DMA Sample Configuration"
    osource "application/samples/peripheral/dma/Kconfig"
endmenu
endif

config SAMPLE_SUPPORT_EFLASH
    bool
    prompt "Support EFLASH Sample."
    default n
    depends on ENABLE_PERIPHERAL_SAMPLE
    help
        This option means support EFLASH Sample.

if SAMPLE_SUPPORT_EFLASH
menu "EFLASH Sample Configuration"
    osource "application/samples/peripheral/eflash/Kconfig"
endmenu
endif

config SAMPLE_SUPPORT_I2C
    bool
    prompt "Support I2C Sample."
    default n
    depends on ENABLE_PERIPHERAL_SAMPLE
    help
        This option means support I2C Sample.

if SAMPLE_SUPPORT_I2C
menu "I2C Sample Configuration"
    osource "application/samples/peripheral/i2c/Kconfig"
endmenu
endif

config SAMPLE_SUPPORT_I2S
    bool
    prompt "Support I2S Sample."
    default n
    depends on ENABLE_PERIPHERAL_SAMPLE
    help
        This option means support I2S Sample.

if SAMPLE_SUPPORT_I2S
menu "I2S Sample Configuration"
    osource "application/samples/peripheral/i2s/Kconfig"
endmenu
endif

config SAMPLE_SUPPORT_I2S_DMA
    bool
    prompt "Support I2S DMA Sample."
    default n
    depends on ENABLE_PERIPHERAL_SAMPLE
    select I2S_SUPPORT_DMA
    help
        This option means support I2S DMA Sample.

if SAMPLE_SUPPORT_I2S_DMA
menu "I2S DMA Sample Configuration"
    osource "application/samples/peripheral/i2s_dma/Kconfig"
endmenu
endif

config SAMPLE_SUPPORT_I2S_DMA_LLI
    bool
    prompt "Support I2S DMA lli Sample."
    default n
    depends on ENABLE_PERIPHERAL_SAMPLE
    select I2S_SUPPORT_DMA
    help
        This option means support I2S DMA LLI Sample.

if SAMPLE_SUPPORT_I2S_DMA_LLI
menu "I2S DMA lli Sample Configuration"
    osource "application/samples/peripheral/i2s_dma_lli/Kconfig"
endmenu
endif

config SAMPLE_SUPPORT_KEYSCAN
    bool
    prompt "Support KEYSCAN Sample."
    default n
    depends on ENABLE_PERIPHERAL_SAMPLE
    help
        This option means support KEYSCAN Sample.

config SAMPLE_SUPPORT_PDM
    bool
    prompt "Support PDM Sample."
    default n
    depends on ENABLE_PERIPHERAL_SAMPLE
    help
        This option means support PDM Sample.

if SAMPLE_SUPPORT_PDM
menu "PDM Sample Configuration"
    osource "application/samples/peripheral/pdm/Kconfig"
endmenu
endif

config SAMPLE_SUPPORT_PDM_AMIC
    bool
    prompt "Support PDM AMIC Sample."
    default n
    depends on ENABLE_PERIPHERAL_SAMPLE && ADC_SUPPORT_AMIC
    help
        This option means support PDM AMIC Sample.

if SAMPLE_SUPPORT_PDM_AMIC
menu "PDM AMIC Sample Configuration"
    osource "application/samples/peripheral/pdm_amic/Kconfig"
endmenu
endif

config SAMPLE_SUPPORT_PINCTRL
    bool
    prompt "Support PINCTRL Sample."
    default n
    depends on ENABLE_PERIPHERAL_SAMPLE
    help
        This option means support PINCTRL Sample.

if SAMPLE_SUPPORT_PINCTRL
menu "PINCTRL Sample Configuration"
    osource "application/samples/peripheral/pinctrl/Kconfig"
endmenu
endif

config SAMPLE_SUPPORT_PWM
    bool
    prompt "Support PWM Sample."
    default n
    depends on ENABLE_PERIPHERAL_SAMPLE
    help
        This option means support PWM Sample.

if SAMPLE_SUPPORT_PWM
menu "PWM Sample Configuration"
    osource "application/samples/peripheral/pwm/Kconfig"
endmenu
endif

config SAMPLE_SUPPORT_QDEC
    bool
    prompt "Support QDEC Sample."
    default n
    depends on ENABLE_PERIPHERAL_SAMPLE
    help
        This option means support QDEC Sample.

if SAMPLE_SUPPORT_QDEC
menu "QDEC Sample Configuration"
    osource "application/samples/peripheral/qdec/Kconfig"
endmenu
endif

config SAMPLE_SUPPORT_RTC
    bool
    prompt "Support RTC Sample."
    default n
    depends on ENABLE_PERIPHERAL_SAMPLE
    help
        This option means support RTC Sample.

if SAMPLE_SUPPORT_RTC
menu "RTC Sample Configuration"
    osource "application/samples/peripheral/rtc/Kconfig"
endmenu
endif

config SAMPLE_SUPPORT_SFC
    bool
    prompt "Support SFC Sample."
    default n
    depends on ENABLE_PERIPHERAL_SAMPLE
    help
        This option means support SFC Sample.

if SAMPLE_SUPPORT_SFC
menu "SFC Sample Configuration"
    osource "application/samples/peripheral/sfc/Kconfig"
endmenu
endif

config SAMPLE_SUPPORT_SPI
    bool
    prompt "Support SPI Sample."
    default n
    depends on ENABLE_PERIPHERAL_SAMPLE
    help
        This option means support SPI Sample.

if SAMPLE_SUPPORT_SPI
menu "SPI Sample Configuration"
    osource "application/samples/peripheral/spi/Kconfig"
endmenu
endif

config SAMPLE_SUPPORT_SYSTICK
    bool
    prompt "Support SYSTICK Sample."
    default n
    depends on ENABLE_PERIPHERAL_SAMPLE
    help
        This option means support SYSTICK Sample.

config SAMPLE_SUPPORT_TASKS
    bool
    prompt "Support TASKS Test Sample."
    default n
    depends on ENABLE_PERIPHERAL_SAMPLE
    help
        This option means support TASKS Test Sample.

config SAMPLE_SUPPORT_TCXO
    bool
    prompt "Support TCXO Sample."
    default n
    depends on ENABLE_PERIPHERAL_SAMPLE
    help
        This option means support TCXO Sample.

config SAMPLE_SUPPORT_TIMER
    bool
    prompt "Support TIMER Sample."
    default n
    depends on ENABLE_PERIPHERAL_SAMPLE
    help
        This option means support TIMER Sample.

if SAMPLE_SUPPORT_TIMER
menu "TIMER Sample Configuration"
    osource "application/samples/peripheral/timer/Kconfig"
endmenu
endif

config SAMPLE_SUPPORT_UART
    bool
    prompt "Support UART Sample."
    default n
    depends on ENABLE_PERIPHERAL_SAMPLE
    help
        This option means support UART Sample.

if SAMPLE_SUPPORT_UART
menu "UART Sample Configuration"
    osource "application/samples/peripheral/uart/Kconfig"
endmenu
endif

config SAMPLE_SUPPORT_WDT
    bool
    prompt "Support WATCHDOG Sample."
    default n
    depends on ENABLE_PERIPHERAL_SAMPLE
    help
        This option means support WATCHDOG Sample.

if SAMPLE_SUPPORT_WDT
menu "WATCHDOG Sample Configuration"
    osource "application/samples/peripheral/watchdog/Kconfig"
endmenu
endif

config SAMPLE_SUPPORT_EVENT
    bool
    prompt "Support EVENT Sample."
    default n
    depends on ENABLE_PERIPHERAL_SAMPLE
    help
        This option means support EVENT Sample.

config SAMPLE_SUPPORT_THREAD
    bool
    prompt "Support THREAD Sample."
    default n
    depends on ENABLE_PERIPHERAL_SAMPLE
    help
        This option means support THREAD Sample.

if SAMPLE_SUPPORT_THREAD
menu "Thread Sample Configuration"
    osource "application/samples/peripheral/thread/Kconfig"
endmenu
endif

config SAMPLE_SUPPORT_MESSAGE
    bool
    prompt "Support MESSAGE Sample."
    default n
    depends on ENABLE_PERIPHERAL_SAMPLE
    help
        This option means support MESSAGE Sample.

config SAMPLE_SUPPORT_SEMAPHORE
    bool
    prompt "Support Semaphore Sample."
    default n
    depends on ENABLE_PERIPHERAL_SAMPLE
    help 
        This option means support SEMAPHORE.

if SAMPLE_SUPPORT_SEMAPHORE
menu "Semaphore Sample Configuration"
    osource "application/samples/peripheral/semaphore/Kconfig"
endmenu
endif

config SAMPLE_SUPPORT_MUTEX
    bool
    prompt "Support Mutex Sample."
    default n
    depends on ENABLE_PERIPHERAL_SAMPLE
    help 
        This option means support Mutex Sample.

config SAMPLE_SUPPORT_LED
    bool
    prompt "Support LED Sample."
    default n
    depends on ENABLE_PERIPHERAL_SAMPLE
    help
        This option means support LED Sample.

config SAMPLE_SUPPORT_BEEP
    bool
    prompt "Support beep Sample."
    default n
    depends on ENABLE_PERIPHERAL_SAMPLE
    help
        This option means support BEEP Sample.

config SAMPLE_SUPPORT_DC_MOTOR
    bool
    prompt "Support dc_motor Sample."
    default n
    depends on ENABLE_PERIPHERAL_SAMPLE
    help
        This option means support DC_MOTOR Sample.

config SAMPLE_SUPPORT_BUTTON
    bool
    prompt "Support button Sample."
    default n
    depends on ENABLE_PERIPHERAL_SAMPLE
    help
        This option means support BUTTON Sample.

config SAMPLE_SUPPORT_STEP_MOTOR
    bool
    prompt "Support step_motor Sample."
    default n
    depends on ENABLE_PERIPHERAL_SAMPLE
    help
        This option means support STEP_MOTOR Sample.

config SAMPLE_SUPPORT_EXTI
    bool
    prompt "Support exti Sample."
    default n
    depends on ENABLE_PERIPHERAL_SAMPLE
    help
        This option means support EXTI Sample.

config SAMPLE_SUPPORT_MYTIMER
    bool
    prompt "Support MyTimer Sample."
    default n
    depends on ENABLE_PERIPHERAL_SAMPLE
    help
        This option means support MyTimer Sample.

config SAMPLE_SUPPORT_PWM_LED
    bool
    prompt "Support pwm led Sample."
    default n
    depends on ENABLE_PERIPHERAL_SAMPLE
    help
        This option means support pwm led Sample.

config SAMPLE_SUPPORT_UARTDEMO
    bool
    prompt "Support uartDemo Sample."
    default n
    depends on ENABLE_PERIPHERAL_SAMPLE
    help
        This option means support uartDemo Sample.

config SAMPLE_SUPPORT_DS18B20
    bool
    prompt "Support ds18b20 Sample."
    default n
    depends on ENABLE_PERIPHERAL_SAMPLE
    help
        This option means support ds18b20 Sample.

config SAMPLE_SUPPORT_OLED
    bool
    prompt "Support OLED Sample."
    default n
    depends on ENABLE_PERIPHERAL_SAMPLE
    help
        This option means support OLED Sample.

config SAMPLE_SUPPORT_WIFIAP
    bool
    prompt "Support WIFIAP Sample."
    default n
    depends on ENABLE_PERIPHERAL_SAMPLE
    help
        This option means support WIFIAP Sample.

config SAMPLE_SUPPORT_WIFISTA
    bool
    prompt "Support WIFISTA Sample."
    default n
    depends on ENABLE_PERIPHERAL_SAMPLE
    help
        This option means support WIFISTA Sample.

config SAMPLE_SUPPORT_UDP_CLIENT
    bool
    prompt "Support udp_client Sample."
    default n
    depends on ENABLE_PERIPHERAL_SAMPLE
    help
        This option means support udp_client Sample.

config SAMPLE_SUPPORT_TCP_CLIENT
    bool
    prompt "Support tcp_client Sample."
    default n
    depends on ENABLE_PERIPHERAL_SAMPLE
    help
        This option means support tcp_client Sample.

config SAMPLE_SUPPORT_WIFI_MQTT
    bool
    prompt "Support wifi_mqtt Sample."
    default n
    depends on ENABLE_PERIPHERAL_SAMPLE
    help
        This option means support wifi_mqtt Sample.

config SAMPLE_SUPPORT_WIFI_MQTT_HUAWEI_IOTA
    bool
    prompt "Support wifi mqtt_huawei_IoTA Sample."
    default n
    depends on ENABLE_PERIPHERAL_SAMPLE
    help
        This option means support wifi mqtt_huawei_IoTA Sample.

config SAMPLE_SUPPORT_DHT11
    bool
    prompt "Support DHT11 Sample."
    default n
    depends on ENABLE_PERIPHERAL_SAMPLE
    help
        This option means support DHT11 Sample.

config SAMPLE_SUPPORT_HR_SPO2
    bool
    prompt "Support HR_SPO2 Sample."
    default n
    depends on ENABLE_PERIPHERAL_SAMPLE
    help
        This option means support HR_SPO2 Sample.

config SAMPLE_SUPPORT_HC_SR501_BODY
    bool
    prompt "Support HC_SR501_BODY Sample."
    default n
    depends on ENABLE_PERIPHERAL_SAMPLE
    help
        This option means support HC_SR501_BODY Sample.

config SAMPLE_SUPPORT_FAN
    bool
    prompt "Support FAN Sample."
    default n
    depends on ENABLE_PERIPHERAL_SAMPLE
    help
        This option means support FAN Sample.

config SAMPLE_SUPPORT_SAMART_HEALTHCARE
    bool
    prompt "Support Smart healthcare Sample."
    default n
    depends on ENABLE_PERIPHERAL_SAMPLE
    help
        This option means support smart healthcare Sample.


config SAMPLE_SUPPORT_SOIL_SENSOR
    bool
    prompt "Support soil sensor Sample."
    default n
    depends on ENABLE_PERIPHERAL_SAMPLE
    help
        This option means support soil sensor Sample.

config SAMPLE_SUPPORT_GESTURE_SENSOR
    bool
    prompt "Support gesture sensor Sample."
    default n
    depends on ENABLE_PERIPHERAL_SAMPLE
    help
        This option means support gesture sensor Sample.

config SAMPLE_SUPPORT_VOICE_MODULE
    bool
    prompt "Support voice module Sample."
    default n
    depends on ENABLE_PERIPHERAL_SAMPLE
    help
        This option means support voice module Sample.

config SAMPLE_SUPPORT_SMART_AGRICULTURE
    bool
    prompt "Support Smart Agriculture Sample."
    default n
    depends on ENABLE_PERIPHERAL_SAMPLE
    help
        This option means support Smart Agriculture Sample.

config SAMPLE_SUPPORT_SMART_HOME
    bool
    prompt "Support Smart Home Sample."
    default n
    depends on ENABLE_PERIPHERAL_SAMPLE
    help
        This option means support Smart Home Sample.

config SAMPLE_SUPPORT_SMART_GESTURE
    bool
    prompt "Support Smart Gesture Sample."
    default n
    depends on ENABLE_PERIPHERAL_SAMPLE
    help
        This option means support Smart Gesture Sample.

config SAMPLE_SUPPORT_GH719
    bool
    prompt "Support GH719 Microwave sensing module Sample."
    default n
    depends on ENABLE_PERIPHERAL_SAMPLE
    help
        This option means Support GH719 Microwave sensing module Sample.
```
